## conf/layer.conf
```bitbake
# We have a conf and classes directory, add to BBPATH
BBPATH .= ":${LAYERDIR}"

# We have recipes-* directories, add to BBFILES
BBFILES += "${LAYERDIR}/recipes-*/*/*.bb ${LAYERDIR}/recipes-*/*/*.bbappend"

BBFILE_COLLECTIONS += "security-edu"
BBFILE_PATTERN_security-edu = "^${LAYERDIR}/"
BBFILE_PRIORITY_security-edu = "1"

# This should only be incremented on significant changes that will
# cause compatibility issues with other layers
LAYERVERSION_security-edu = "1"

LAYERDEPENDS_security-edu = "core"
```
